## drivers/video/logo/Kconfig
```kconfig
# SPDX-License-Identifier: GPL-2.0-only
#
# Logo configuration
#

menuconfig LOGO
	bool "Bootup logo"
	depends on FB_CORE || SGI_NEWPORT_CONSOLE
	help
	  Enable and select frame buffer bootup logos.
	  Monochrome logos will also be used by the DRM panic handler, if
	  enabled.

if LOGO

config FB_LOGO_EXTRA
	bool
	depends on FB=y
	default y if SPU_BASE

config FB_LOGO_FORCED
	bool "Force number of logos"
	depends on FB=y
	default n
	help
	  This option allows you to force the number of logos to be used.

if FB_LOGO_FORCED

config FB_LOGO_SET_NUM
	int "Number of logos to use"
	depends on FB=y
	default 4
	help
	  This option allows you to force the number of logos to be used.
	  If set to 0, the number of logos is determined by the number of
	  available cpu cores. If set to a value greater than 0, that number
	  of logos will be used.
	
endif # FB_LOGO_FORCED

config LOGO_LINUX_MONO
	bool "Standard black and white Linux logo"
	default y

config LOGO_LINUX_VGA16
	bool "Standard 16-color Linux logo"
	default y

config LOGO_LINUX_CLUT224
	bool "Standard 224-color Linux logo"
	default y

config LOGO_DEC_CLUT224
	bool "224-color Digital Equipment Corporation Linux logo"
	depends on MACH_DECSTATION || ALPHA
	default y

config LOGO_MAC_CLUT224
	bool "224-color Macintosh Linux logo"
	depends on MAC
	default y

config LOGO_PARISC_CLUT224
	bool "224-color PA-RISC Linux logo"
	depends on PARISC
	default y

config LOGO_SGI_CLUT224
	bool "224-color SGI Linux logo"
	depends on SGI_IP22 || SGI_IP27 || SGI_IP32
	default y

config LOGO_SUN_CLUT224
	bool "224-color Sun Linux logo"
	depends on SPARC
	default y

config LOGO_SUPERH_MONO
	bool "Black and white SuperH Linux logo"
	depends on SUPERH
	default y

config LOGO_SUPERH_VGA16
	bool "16-color SuperH Linux logo"
	depends on SUPERH
	default y

config LOGO_SUPERH_CLUT224
	bool "224-color SuperH Linux logo"
	depends on SUPERH
	default y

endif # LOGO
```
